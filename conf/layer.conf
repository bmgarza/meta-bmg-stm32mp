## conf/layer.conf
```bitbake
# We have a conf and classes directory, add to BBPATH
BBPATH .= ":${LAYERDIR}"

# We have recipes-* directories, add to BBFILES
BBFILES += "${LAYERDIR}/recipes-*/*/*.bb \
            ${LAYERDIR}/recipes-*/*/*.bbappend"

BBFILE_COLLECTIONS += "meta-bmg-stm32mp"
BBFILE_PATTERN_meta-bmg-stm32mp = "^${LAYERDIR}/"
BBFILE_PRIORITY_meta-bmg-stm32mp = "6"

LAYERDEPENDS_meta-bmg-stm32mp = "core stm-st-stm32mp"
LAYERSERIES_COMPAT_meta-bmg-stm32mp = "mickledore"
```

## conf/machine/stm32mp-qemuarm64.conf
```bitbake
#@TYPE: Machine
#@NAME: stm32mp-qemuarm64
#@DESCRIPTION: This is an extension of the qemuarm64 machine which uses the stm32mp Linux kernel.

require conf/machine/qemuarm64.conf

MACHINEOVERRIDES =. "stm32mp-qemuarm64:"
KMACHINE = "qemuarm64"

# =========================================================================
# Kernel
# =========================================================================
PREFERRED_PROVIDER_virtual/kernel = "linux-stm32mp"

# =========================================================================
# u-boot
# =========================================================================
# PREFERRED_PROVIDER_virtual/bootloader = "u-boot-stm32mp"
# PREFERRED_PROVIDER_u-boot = "u-boot-stm32mp"


# =========================================================================
# trusted-firmware-a
# =========================================================================
# PREFERRED_PROVIDER_virtual/trusted-firmware-a = "tf-a-stm32mp"

# =========================================================================
# optee-os
# =========================================================================
# PREFERRED_PROVIDER_virtual/optee-os = "optee-os-stm32mp"

# SERIAL_CONSOLE = "115200 ttySTM0"
# SERIAL_CONSOLES = "${@d.getVar('SERIAL_CONSOLE').replace(' ', ';')}"
```
